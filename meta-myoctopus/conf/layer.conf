## meta-myoctopus/conf/layer.conf
```bitbake
BBPATH .= ":${LAYERDIR}"
BBFILES += "${LAYERDIR}/recipes*/*/*.bb ${LAYERDIR}/recipes*/*/*.bbappend"
BBFILE_COLLECTIONS += "meta-myoctopus"
BBFILE_PATTERN_meta-myoctopus := "^${LAYERDIR}/"
BBFILE_PRIORITY_meta-myoctopus = "1"

#PREFERRED_VERSION_linux-yocto-custom = "3.18"
PREFERRED_VERSION_python3 = "3.4.2"
PREFERRED_VERSION_python3-native = "3.4.2"

# enable systemd as default init manager
DISTRO_FEATURES_append = " systemd"
VIRTUAL-RUNTIME_init_manager = "systemd"
DISTRO_FEATURES_BACKFILL_CONSIDERED = "sysvinit"
VIRTUAL-RUNTIME_initscripts = ""

# add required packages
IMAGE_INSTALL_append = " python3-modules"

CPPFLAGS_append_pn-ncurses-native = " -P"
CFLAGS_append_pn-binutils = " -Wno-error"
CFLAGS_append_pn-binutils-native = " -Wno-error"
```
